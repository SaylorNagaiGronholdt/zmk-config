## config/Kconfig.defconfig
```kconfig
if SHIELD_ERGOGAMIV1_LEFT

# Name must be less than 16 characters long!
config ZMK_KEYBOARD_NAME
    default "ergoGami_v1"

config ZMK_SPLIT_ROLE_CENTRAL
    default y

endif

if SHIELD_ERGOGAMI_LEFT || SHIELD_ERGOGAMI_RIGHT

config ZMK_SPLIT
    default y

endif
```

## config/boards/shields/ergoGami_v1_right/Kconfig.defconfig
```kconfig
# Define the keyboard name
config ZMK_KEYBOARD_NAME
    default "ergoGami_v1"

# Enable split role if the left shield is present
if SHIELD_ERGOGAMIV1_LEFT
    config ZMK_SPLIT_ROLE_CENTRAL
        default y
endif

# Enable split configuration if either left or right shield is present
if SHIELD_ERGOGAMI_LEFT || SHIELD_ERGOGAMI_RIGHT
    config ZMK_SPLIT
        default y
endif
```

## config/boards/shields/ergoGami_v1_right/Kconfig.shield
```kconfig
# No whitespace after the comma or in your part name!
config SHIELD_ERGOGAMIV1_RIGHT
    def_bool $(shields_list_contains,ergoGami_v1_right)
```

## config/ergoGami_v1_left/Kconfig.shield
```kconfig
# No whitespace after the comma or in your part name!
config SHIELD_ERGOGAMIV1_LEFT
    def_bool $(shields_list_contains,ergoGami_v1_left)
```
